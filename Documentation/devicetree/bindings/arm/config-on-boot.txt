## Documentation/devicetree/bindings/arm/config-on-boot.txt
```
* Configure on Boot

Node name: config-on-boot
  It must be in root node. config-on-boot means to describe settings that needs
  to be set one time on boot but aren't owned by any driver, or the owned driver
  is too generic to handle such settings. For example, usb hub uses generic
  driver in usb core code, a on-board usb may need deassert reset pin.

Optional properties:
- output-gpios: Output gpio array that needs to set.
- output-gpio-values: This property is required if output-gpios is set.
  The value is a array of 0 or 1. Total count eaquals the number of gpios.
```

## Documentation/devicetree/bindings/serial/fsl-imx-uart.txt
```
* Freescale i.MX Universal Asynchronous Receiver/Transmitter (UART)

Required properties:
- compatible : Should be "fsl,<soc>-uart"
- reg : Address and length of the register set for the device
- interrupts : Should contain uart interrupt

Optional properties:
- fsl,uart-has-rtscts : Indicate the uart has rts and cts
- fsl,irda-mode : Indicate the uart supports irda mode
- fsl,dte-mode : Indicate the uart works in DTE mode. The uart works
                  is DCE mode by default.
- panduit,vmx-rs485-mode: Indicate the UART works in Panduit VMX RS485 mode.
- panduit,port0-de-gpio: configure GPIO for RS485 port0 DE.
- panduit,port0-re-gpio: configure GPIO for RS485 port0 RE.
- panduit,port1-de-gpio: configure GPIO for RS485 port1 DE.
- panduit,port1-re-gpio: configure GPIO for RS485 port1 RE.

Note: Each uart controller should have an alias correctly numbered
in "aliases" node.

Example:

aliases {
	serial0 = &uart1;
};

uart1: serial@73fbc000 {
	compatible = "fsl,imx51-uart", "fsl,imx21-uart";
	reg = <0x73fbc000 0x4000>;
	interrupts = <31>;
	fsl,uart-has-rtscts;
	fsl,dte-mode;
};
```

## Documentation/devicetree/bindings/usb/ci13xxx-imx.txt
```
* Freescale i.MX ci13xxx usb controllers

Required properties:
- compatible: Should be "fsl,imx31-usb"
- reg: Should contain registers location and length
- interrupts: Should contain controller interrupt

Optional properties:
- fsl,usbphy: phandler of usb phy that connects to the only one port
- fsl,hub-reset-gpios: gpio used to reset on-board usb hub
- fsl,vbus-power-gpios: gpio used to set vbus power of the only one port

Examples:
usb@02184000 { /* USB OTG */
	compatible = "fsl,imx6q-usb", "fsl,imx31-usb";
	reg = <0x02184000 0x200>;
	interrupts = <0 43 0x04>;
	fsl,usbphy = <&usbphy1>;
	fsl,vbus-power-gpios = <&gpio3 22 0>;
};
```
